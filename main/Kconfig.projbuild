## main/Kconfig.projbuild
```kconfig
menu "Proxmox Display Configuration"

    menu "WiFi"
        config WIFI_SSID
            string "WiFi SSID"
            default "myssid"
        config WIFI_PASSWORD
            string "WiFi Password"
            default "mypassword"
    endmenu

    menu "Proxmox API"
        config PROXMOX_HOST
            string "Proxmox Host"
            default "10.0.0.10"
        config PROXMOX_PORT
            int "Proxmox Port"
            default 8006
        config PROXMOX_NODE
            string "Proxmox Node Name"
            default "pve"
        config PROXMOX_API_TOKEN
            string "API Token (USER@REALM!TOKENID=SECRET)"
            default ""
    endmenu

    menu "Display GPIO"
        config LCD_CLK_GPIO
            int "SPI Clock GPIO"
            range 0 30
            default 6
        config LCD_MOSI_GPIO
            int "SPI MOSI GPIO"
            range 0 30
            default 7
        config LCD_CS_GPIO
            int "LCD CS GPIO"
            range 0 30
            default 14
        config LCD_DC_GPIO
            int "LCD DC GPIO"
            range 0 30
            default 15
        config LCD_RST_GPIO
            int "LCD Reset GPIO"
            range 0 30
            default 21
        config LCD_BL_GPIO
            int "LCD Backlight GPIO"
            range 0 30
            default 22
    endmenu

    config REFRESH_INTERVAL_MS
        int "Refresh interval (ms)"
        default 15000

endmenu
```

## sdkconfig.defaults
```kconfig
# Valeurs par défaut — credentials réels dans sdkconfig.defaults.local (non-tracké)
CONFIG_IDF_TARGET="esp32c6"
CONFIG_FREERTOS_HZ=1000
CONFIG_ESP_MAIN_TASK_STACK_SIZE=8192
CONFIG_MBEDTLS_SSL_IN_CONTENT_LEN=8192
CONFIG_MBEDTLS_SSL_OUT_CONTENT_LEN=4096
CONFIG_PARTITION_TABLE_CUSTOM=y
CONFIG_PARTITION_TABLE_CUSTOM_FILENAME="partitions.csv"
CONFIG_PARTITION_TABLE_OFFSET=0x8000

# LVGL fonts requis par le dashboard
CONFIG_LV_FONT_MONTSERRAT_10=y
CONFIG_LV_FONT_MONTSERRAT_12=y
CONFIG_LV_FONT_MONTSERRAT_16=y
CONFIG_LV_FONT_MONTSERRAT_24=y
```
